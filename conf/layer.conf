## conf/layer.conf
```bitbake
# We have a conf and classes directory, add to BBPATH
BBPATH .= ":${LAYERDIR}"

# We have recipes-* directories, add to BBFILES
BBFILES += "${LAYERDIR}/recipes-*/*/*.bb \
            ${LAYERDIR}/recipes-*/*/*.bbappend \
            ${LAYERDIR}/images/*.bb"

BBFILE_COLLECTIONS += "meta-maaxboard"
BBFILE_PATTERN_meta-maaxboard = "^${LAYERDIR}/"
# Priority should higher than NXP BSP (priority:8)
BBFILE_PRIORITY_meta-maaxboard = "9"
LAYERVERSION_meta-maaxboard = "1"
LAYERSERIES_COMPAT_meta-maaxboard = "langdale"

MACHINE_EXTRA_RRECOMMENDS:append  = " uenv"

# Avnet Github Mirror
MAAXBOARD_GIT_HOST_MIRROR ?= "git://github.com/Avnet"
MAAXBOARD_GIT_PROTOCOL ?= "protocol=https"
MAAXBOARD_GIT_USER ?= ""

IMAGE_INSTALL:append = "\
   curl \
   python3-opencv \
   python3-azure-iot-device \
   python3-microdot \
   python3-numpy \
   python3-psutil \
   python3-pycairo \
   python3-pycryptodome \
   python3-pyserial \
   web-server-demo \
"
# python3-tendo
# python3-opencv
# python3-opencv-headless
```
